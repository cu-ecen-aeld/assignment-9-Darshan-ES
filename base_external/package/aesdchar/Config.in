## base_external/package/aesdchar/Config.in
```kconfig
config BR2_PACKAGE_AESDCHAR
    bool "aesdchar"
    help
      This package installs the package for aesdchar.
```

## base_external/package/ldd/Config.in
```kconfig
config BR2_PACKAGE_LDD
    bool "LDD Kernel Modules"
    help
      This package installs the misc-modules and scull.
```
